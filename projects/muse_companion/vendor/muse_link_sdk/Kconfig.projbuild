## projects/muse_companion/vendor/muse_link_sdk/Kconfig.projbuild
```kconfig
rsource "upstream/Kconfig.projbuild"

config MUSE_ENABLED
    bool
    default y

config MUSE_BOARD_ID
    string
    default "mosaico"
```
